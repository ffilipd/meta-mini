## conf/layer.conf
```bitbake
# We have a conf and classes directory, add to BBPATH
BBPATH .= ":${LAYERDIR}"

# We have recipes-* directories, add to BBFILES
BBFILES += "${LAYERDIR}/recipes-*/*/*.bb \
            ${LAYERDIR}/recipes-*/*/*.bbappend"

BBFILE_COLLECTIONS += "meta-mini"
BBFILE_PATTERN_meta-mini = "^${LAYERDIR}/"
BBFILE_PRIORITY_meta-mini = "6"

LAYERDEPENDS_meta-mini = "core"
LAYERSERIES_COMPAT_meta-mini = "hardknott"

API_URI="192.168.132.153"
```
